        NAM     PROMDIR
*
* THIS PROGRAM LISTS THE PROM BASED DIRECTORY
* REQUIRES THE CÅ-836 EPROM CARD AND LOADING 
* OF PROM.BIN IN STARTUP.TXT
* A CRUDE CONTROL IS BUILT IN THAT CHECKS IF
* FIRST CHARACTER IN THE DIRECTORY AT $E400
* IS ALPHA NUMERIC.
*
* VERSION 1.0 2024-06-14
* INITIAL RELEASE
*
TABELL  EQU     $E400     WHERE OUR DIRECTIRY IS
WARMS   EQU     $CD03     FLEX VARM START
CLASS   EQU     $CD21     CLASSIFY CHARACTER FLEX-ROUTINE
OUTCH   EQU     $CD0F     PRINT ONE CHARACTER VIA FLEX
PCRLF   EQU     $CD24     PRINT CARRIAGE RETURN AND LINE FEED
SIGNTR  EQU     $E7F7     SIGNATURE AREA
*
        ORG     $C100     STANDARD START ADDRESS FOR FLEX UTILS
*
START   BRA     START1    SKIP OVER VERSION NUMBER
        FCB     3         VERSION
START1  BRA     KOLL      CHECK IF DIRECTORY IS THERE
START2  LDX     #TEXT1    YES, THEN PRINT HEADER
        JSR     PSTRNG    AND RUN PROGRAM
        LDY     PRGNAM    PLACE HOLDER FOR DIRECTORY NAME
        LDX     #TABELL   LOAD DIRECTORY TO X
        LDB     #5        FIVE TABS
        STB     TABS      SAVE TABS COUNTER
        LDB     #$E       CRUDE TABULATOR CALCULATOR
LOOP    LDA     ,X+       READ ONE CHARACTER
        CMPA    #$0       IS IT 0
        BEQ     PRINTIT   YES, THEN PRINT THE DIRECTORY ENTRY
        STA     0,Y+      NO, STORE THE CHARACTER IN PRGNAM
        DECB              CONT DOWN CHARACTERS
        BRA     LOOP      READ AGAIN
*
* PRINT THE DIRECTORY ENTRY, CHECKS IF WE HAVE REACHED 
* END OF DIRECTORY TABLE
*
PRINTIT LDA     #$4       EOT
        STA     0,Y       REPLACE 0 WITH EOT
        PSHS    X         SAVE X
        LDX     PRGNAM    OUR DIRECTORY ENTRY
        JSR     PSTRNG    PRINT IT
        LDA     #$20      SPACE CHARACTER
SPACE   JSR     OUTCH     PRINT IT
        DECB              DECREMENT B
        CMPB    #0        MORE SPACES TO PRINT?
        BNE     SPACE     YES, LOOP
        LDA     TABS      LOAD TABS COUNTER
        CMPA    #0        ARE WE DOWN TO LAST TAB?
        BNE     TAB2      NO, CONTINUE
        JSR     PCRLF     YES, PRINT CR LF
        LDA     #6        RESET TABS COUNTER
        STA     TABS      SAVE IT IN TABS
*
TAB2    DECA              DECREMENT TABS
        STA     TABS      AND SAVE IT
        PULS    X         RESTORE X
        LDB     #$E       RESTORE COUNTER
        INX               SKIP TWO BYTES
        INX               TO GET TO NEXT DIRECTORY ENTRY
        LDA     ,X        READ ONE CHARACTER
        CMPA    #$0       IS IT 0?
        BEQ     SLUT      YES, END OF DIRECTORY TABLE
        LDY     PRGNAM    NO, RESET PRGNAM
        BRA     LOOP      READ NEXT DIRECTORY ENTRY
*
* PRINT A STRING, CAN'T USE FLEX PRINT STRING AS IT
* ADDS CR LF PRIOR TO PRINT THE STRING
*
PSTRNG  PSHS    A         SAVE A
PSTR1   LDA     ,X+       GET A CHARACTER, INCREASE X
        CMPA    #4        END OF TEXT?
        BNE     PRINTCH   NO, PRINT THE CHARACTER
        PULS    A,PC      RESTORE A AND PC
*
PRINTCH JSR     OUTCH     PRINT A CHARACTER VIA FLEX
        BRA     PSTR1     NEXT CHARACTER
*
* CHECK IF THE DIRECTORY IS IN PLACE
* NOT FAIL SAFE, BIT IT IS A START
* I MIGHT REWRITE THE CODE TO BE ABSOLUTELY
* FAIL SAFE
*
KOLL    LDX     #SIGNTR   START OF SIGNATURE E8
        CLRA              CLEAR A
        ADDA    0,X       ADD FIRST CHARACTER
        ADDA    1,X       ADD SECOND CHARACTER
        ADDA    2,X       ADD THIRD CHARACTER
        CMPA    #$E8      IS IT E8?
        BEQ     START2    YES, LIST THE DIRECTORY TABLE
*
NEJ     LDX     #INGENK   TEXT NO CATALOG FOUND
        JSR     PSTRNG    PRINT THE STRING
        BRA     SLUT      QUIT
*
* TEXT STRINGS
*
TEXT1   FCB     $1B,5     CLEAR SCREEN
        FCB     $0D,$0A,$0D,$0A
        FCC     'Program i EPROM-katalogen:'
        FCB     $0D,$0A,4
INGENK  FCC     'Ingen katalog hittad'
        FCB     $0D,$0A,4
*
PRGNAM  RMB     9         PLACE HOLDER FOR DIRECTORY ENTRY
TABS    RMB     1         PLACE HOLDER FOR TABS
*
SLUT    JMP     WARMS     JUMP TO FLEX
        END     START    

