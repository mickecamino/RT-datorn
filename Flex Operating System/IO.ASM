        NAM    I/O DRIVER PACKAGE
*
* COPYRIGHT 1984 PERIPHERAL TECHNOLOGY
* ALL RIGHTS RESERVED
*
* MODIFICATIONS BY MIKAEL KARLSSON 2024
* TO FIT RT-DATORN, BOTH THE "OLD" AND THE
* "NEW".
* ALL CALLS ARE NOW CBUG CALLS INTO
* THE S-BUG EQUIVALENT ADDRESSES
*
* RT-DATORN EQUATES
* VECTORED ADDRESSES FOR INDIRECT JUMPS
* COMPATIBLE WITH SWTPC S-BUG
*
RTMON   EQU    $F800     CBUG 4.3 (2.3) START
RTINPNE EQU    $F804     CBUG 4.3 (2.3) INCH
RTINPUT EQU    $F806     CBUG 4.3 (2.3) INCHE
INCHEK  EQU    $F808     CBUG 4.3 (2.3) INCHEK
RTOUT   EQU    $F80A     CBUG 4.3 (2.3) OUTCH
*
* FLEX EQUATES
*
CHPR    EQU    $C700     SPOOLER
COLD    EQU    $CD00     COLD START IN FLEX
*
        ORG    $D3E5     START OF VECTOR TABLE
*
* I/O VECTOR TABLE
*
*---------------------------------------------------
INCH1   FDB    INCH2     * INPUT CHARACTER - NO ECHO
IHNDLR  FDB    IHND      * IRQ INTERRUPT HANDLER
SWIVEC  FDB    $DFC2     * SWI3 VECTOR LOCATION
IRQVEC  FDB    $DFC8     * IRQ VECTOR LOCATION
TMOFF   FDB    TOFF      * TIMER OFF ROUTINE
TMON    FDB    TON       * TIMER ON ROUTINE
TMINIT  FDB    TINT      * TIMER INITIALIZE ROUTINE
MONITOR FDB    MON       * MONITOR RETURN
TINIT   FDB    INIT      * TERMINAL INITALIZATION
STAT    FDB    STATUS    * CHECK CHARACTER RECEIVED
OUTCH   FDB    OUTPUT    * TERMINAL CHARACTER OUTPUT
INCH    FDB    INPUT     * TERMINAL CHARACTER INPUT
*---------------------------------------------------
*
        ORG    $D370     START OF ROUTINES
*
* RETURN TO MONITOR
*
MON     JMP    [RTMON]   GO BACK TO CBUG
*
* TERMINAL INITALIZATION NOT USED IN RT-DATORN
*
INIT    RTS              JUST RTS BACK
*
* TERMINAL CHARACTER INPUT ROUTINE
*
INPUT   JMP    [RTINPUT]
*
* INPUT CHARACTER WITH NO ECHO
*
INCH2   JMP    [RTINPNE]
*
* TERMINAL CHARACTER RECEIVED CHECK
*
STATUS  JMP    [INCHEK]
*
* TERMINAL CHARACTER OUTPUT ROUTINE
*
OUTPUT  JMP    [RTOUT]
*
* IRQ INTERRUPT HANDLER
*
IHND    RTS              NOT USED FOR NOW
*
* TIMER INITIALIZE ROUTINE
*
TINT    RTS              NOT USED FOR NOW
*
* TIMER ON ROUTINE
*
TON     RTS              NOT USED FOR NOW
*
* TIMER OFF ROUTINE
*
TOFF    RTS              NOT USED FOR NOW
*
        END    COLD      MUST HAVE TRANSFER ADDRESS!

