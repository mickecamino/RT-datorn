*
* PROGRAM F\R RELOKERING UTAV BIN[R-FILER
*
* UR MPU-LAREN NR.3 1981
*
* SYNTAX :
* RELOCATE <OLDFILE>,<NEWFILE>,OFFSET
*
* D[R
* OLDFILE=URSPRUNGS-BIN[R-PROGRAM
* NEWFILE=NY RELOCERAD FIL
* OFFSET =V[RDE ADDERAD TILL ABSOLUT ADRESSEN I MINNET
*
        ORG    $C100     'UTILITY COMMAND AREA'
START   BRA    START2
        FCB    2         VERSIONS-NR.
*
*
* SUBRUTIN F\R INMATNING AV EN FIL
* TILL ETT FIL-KONTROLL-BLOCK
*
GETFLE  JSR    GETFIL    H[MTA FILSPEC
        BCS    LEAVE     OM FEL ]TERG]
        CLRA             S[TT EN .BIN 'EXTENSION'
        JSR    SETEXT    OM INGEN ANNAN [R ANGIVEN
        CLC              MARKERA OK
LEAVE   RTS              ]TERG]
*
*
* START UTAV PROGRAMMET
*
START2  LEAX   FCBR,PCR  X=L[SANDE FCB
        BSR    GETFLE    H[MTA FIL-SPECIFIKATION
        BCS    FMSERR    OM FELAKTIG G] TILL RAPPORTERING
        LDA    #1        \PPNA F\R L[SNING
        LBSR   DOFMS
        BNE    FMSERR
        LDA    #$FF      MARKERA BIN[R-FIL
        STA    59,X
**
        LEAX   FCBW,PCR  H[MTA FILNAMNET F\R SKRIV-FILEN
        BSR    GETFLE
        BCS    FMSERR
*
        JSR    GETHEX    H[MTA ETT HEX-TAL TILL X-REG.
        BCS    SYNTAX    HOPPA OM FEL
        STX    OFFST,PCR SPARA ANGIVEN OFFSET
*
OPENWR  LDA    #2        \PPNA FILEN F\R SKRIVNIN
        LBSR   WDOFMS
        BEQ    CONTIN    OM INGET FEL HOPPA
*
        LDA    1,X       TESTA OM FILEN REDAN FINNS
        CMPA   #3
        BNE    FMSERR    OM S] EJ VAR FALLET RAPPORTERA
*
REPEAT  LEAX   STRN01,PCR G]R DET BRA ATT 'DELETA' FILEN
        JSR    PSTRNG    FR]GA
        JSR    GETCHR    H[MTA IN SVAR TILL ACC-A
        CMPA   #'N       VILL HAN INTE 'DELETA'?
        BEQ    CLOSER    OM S] VAR FALLET S] AVSLUTAR VI
        CMPA   #'Y       HAR HAN SVARAT 'Y'
        BNE    REPEAT    OM INTE S] FR]GAR VI OM IGEN.
        LDA    #12       NU TAS DEN BEFINTLIGA FILEN BORT
        BSR    WDOFMS
        BNE    FMSERR    OM FEL RAPPORTERA
        LDA    36,X      ]TERST[LL BIT 7 I FIL-SPEC
        STA    4,X       F\RSTA BYTE S[TTES 1 VID DELETE
        BRA    OPENWR    ETT NYTT F\RS\K ATT \PPNA FILEN
*
SYNTAX  LEAX   FCBR,PCR  RAPPORTERA 'SYNTAX'-FEL
        LDA    #26
        STA    1,X
FMSERR  JSR    RPTERR    RAPPORTERA FEL <ENLIGT FELKOD>
CLOSER  JSR    FMSCLS    ST[NG ALLA FILER
EXIT    JMP    WARMS     ]TERG] TILL 'FLEX'
*
* H[R FORTS[TTER PROGRAMMET SEDAN VI \PPNAT FILERNA
*
CONTIN  LDA    #$FF      MARKERA BIN[RFIL
        STA    59,X
*
        BSR    BOFREC    G] OCH JOBBA
        BNE    FMSERR
        JSR    PCRLF
        LEAX   STRN02,PCR RAPPORTERA ATT DET VAR KLART
        JSR    PSTRNG
        JSR    PCRLF
        BRA    EXIT
*
* S\K EFTER B\RJAN TILL EN 'RECORD'
* ELLER B\RJAN TILL EN START-ADDRESS
*
BOFREC  BSR    READ      L[S EN BYTE
        CMPA   #2        [R DET EN START AV 'RECORD'?
        BEQ    RECFND
        CMPA   #$16      'TRANSFER-ADDRESS'?
        BNE    BOFREC    OM EJ FORTS[TT ATT S\KA
        BSR    WRITE     SKRIV TILLBAKS $16
        BSR    RWOFFS    L[S & SKRIV EN ADD. MED OFFSET
        BEQ    BOFREC    FORTS[TT S\KANDET
        RTS
*
RECFND  BSR    WRITE     SKRIV TILLBAKS
        BSR    RWOFFS    L[S & SKRIV EN ADD. MED OFFSET
        BNE    RETURN
        BSR    READ       L[S UT ANTAL BYTE I RECORDEN
        TFR    A,B
        BSR    WRITE     SKRIV TILLBAKS DEN
        TSTB             [R DET EN TOM RECORD?
        BEQ    BOFREC    OM JA HOPPA
MOVLOP  BSR    READ      L[S SAMT SKRIV TILL SLUT
        BSR    WRITE
        DECB             SISTA I RECORD?
        BNE    MOVLOP    OM EJ FORTS[TT
        BRA    BOFREC    LETA EFTER NY RECORD
*
* L[S EN BYTE-SUBRUTIN OBS! STACKAD RETUR-VECTOR
*
READ    LEAX   FCBR,PCR
        BSR    FMSC
        BEQ    RETURN
        LEAS   2,S       SKIPPA RETUR ADDRESS
*
        LDA    1,X       H[MTA FEL-CODEN
        CMPA   #8        TESTA OM FELCOD 'SLUT P] FILEN'
        BNE    RETURN
        LDA    #4        ST[NG L[SFILEN
        BSR    DOFMS
        BNE    RETURN
        LDA    #4        ST[NG FILEN F\R SKRIVNING
*
WDOFMS  LEAX   FCBW,PCR
*
* SUBRUTIN F\R ATT G\RA EN FMS-FUKTION
* FUKTIONS-NUMRET FINNS I ACC-A
*
DOFMS   STA    0,X
FMSC    JMP    FMS
*
* L[S IN 2-BYTAR ADDERA OFFSETEN SAMT SKRIV
* TILLBAKS DESSA.
*
RWOFFS  BSR    READ      L[S EN BYTE (MSB)
        TFR    A,B       SPARA I B-ACC
        BSR    READ      L[S EN BYTE TILL (LSB)
        EXG    A,B       A OCH B [R FEL BYT PLATS P] DESSA
        ADDD   OFFST,PCR ADDERA ANGIVEN OFFSET
        BSR    WRITE     SKRIV IN [NDRING I D-ACC
        TFR    B,A
*
WRITE   LEAX   FCBW,PCR  SKRIV EN BYTE SUBRUTIN
        BSR    FMSC
        BEQ    RETURN
        LEAS   2,S       SKIPPA RETUR1
RETURN  RTS
*
* TEXT-STR[NGAR
*
STRN01  FCC    'DELETE OLD BINARY ?',4
STRN02  FCC    'RELOCATE IS COPLETE !',4
*
* VARIABLER
*
        RMB    1
OFFST   RMB    2         H[R LAGRAS ANGIVEN OFFSET
RECLEN  RMB    1         ANV. F\R ATT H]LLA REDA P] ANTAL DATA I EN 'RECORD
FCBR    RMB    320       FIL-KONTROLL BLOCK F\R L[SNING
FCBW    RMB    320       FIL-KONTROLL BLOCK F\R SKRIVNING
*
* EXTERNA FLEX SYSTEM SUBRUTINER
*
WARMS   EQU    $CD03     VARM-START-ADDRESS F\R FLEX
GETCHR  EQU    $CD15     H[MTA ETT TECKEN FR]N TERMINAL
PSTRNG  EQU    $CD1E     SKRIV EN TEXTSTR[NG
PCRLF   EQU    $CD24     RAD-FRAMMATNING
GETFIL  EQU    $CD2D     H[MTA EN FIL-SPECIFIKATION
SETEXT  EQU    $CD33     S[TT EN EXTENSION
RPTERR  EQU    $CD3F     RAPPORTERA FEL (I FCB)
GETHEX  EQU    $CD42     H[MTA SPECIFIERAT HEXADECIMALT TECKEN
FMSCLS  EQU    $D403     ST[NG SAMTLIGA FILER
FMS     EQU    $D406     KALLA P] FIL-HANTERINGS-SYSTEMET
        END    START     SLUT P] RELOCATE
