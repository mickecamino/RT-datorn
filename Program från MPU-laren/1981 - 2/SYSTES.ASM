*
        NAM    SYSTEM
        ORG    $C100
*
* SNABB TEST AV SYSTEM-PROGRAMVARAN I FLEX 9.0
* UR MP-ULAREN NR.2 1981
* NEDKNACKAT AV A. BRATT 1982.05.11
*
START   BRA    START2
        FCB    1         VERSIONSNUMMER
CHECKS  FDB    $199F     BER[KNAD CHECKSUMMA
START2  LEAY   TABL,PCR  PEKA P] TABELLEN
        LDD    #0        CHECKSUM-INITIALISERING
SUMLP1  LDX    0,Y++     H[MTA ADDRESSOMR]DETS B\RJAN
SUMLP2  ADDB   0,X+      ADDERA DATA TILL CHECKSUMMA
        ADCA   #0        ADDERA 'CARRY' FR]N F\REG]ENDE
        CMPX   0,Y       TESTA OM SLUT P] ADDRESSOMR]DE
        BLS    SUMLP2    OM EJ S] FORTS[TT ATT ADDERA BYTAR
        LEAY   2,Y       HOPPA \VER SLUTADDRESSEN
        TST    0,Y       TESTA OM SISTA ADDRESSOMR]DE
        BNE    SUMLP1    OM EJ 0 S] TAG N[STA ADDRESSOMR]DE
        CMPD   CHECKS    J[MF\R OM LIKA MED F\RV[NTAT
        BEQ    OKTES     OM DET VAR OK HOPPA
        STD    CHECKS    UPPDATERA CKECK-SUMMAN I MINNET
        LDX    #STRNG2   RAPPORTERA FELAKTIGT
        LDA    #20       MARKERA FEL NR. 20 TILL FLEX
        STA    ERRTYP
REPORT  JSR    PSTRNG    SKRIV UT EN STR[NG D[R X-PEKAR
        JMP    WARMS     ]TERG] TILL FLEX
OKTES   LDX    #STRNG1   RAPPORTERA TEST OK !!!!
        BRA    REPORT    SKRIV UT
*
* TEXT-STR[NGAR
*
STRNG1  FCC    'SYSTEM SOFTWARE IS INTACT',4
STRNG2  FCC    'SYSTEM CHECKSUM ERROR REBOOT SYSTEM',4
*
* DETTA [R EN TABELL MED ADDRESS-OMR]DEN (START-STOPP)
* VILKEN TALAR OM VAR I FLEX 9.0 SOM DET
* FINNS PROGRAM-VARA SOM [R OF\R[NDERLIG
TABL    FDB    $C700,$C712 (START,SLUT)
        FDB    $C71F,$C804
        FDB    $CC4E,$CCA7
        FDB    $CD00,$D3D1
        FDB    $D3E1,$D3FD
        FDB    $D400,$D408
        FDB    $D436,$DDE2
        FDB    $DE00,$DE17
        FDB    $DE26,$DF4D
        FDB    0         SLUT P] TABELL-MARKERING
*
ERRTYP  EQU    $CC20     FEL-NUMMER VEKTOR I FLEX
WARMS   EQU    $CD03     WARMSTARTS-ADDRESS TILL FLEX
PSTRNG  EQU    $CD1E     SKRIV UT EN TEXTSTR[NGS-RUTIN
        END    START     AVSLUTA MED START TILL B\RJAN UTAV PROGRAMMET
