        NAM    DISKSPD
        OPT    PAG
*
* DISK SPEED CHECK UTILITY
* FROM 68 MICRO JOURNAL JUNE 84 P.28
*
* THIS UTILITY COMMAND CHECKS THE MOTOR SPEED
* OF THE SPECIFIED DRIVE. A 5 INCH DISK
* MUST BE IN THE SPECIFIED DRIVE. NO WRITING
* TO THE DISK IS PERFORMED. A SOFTWARE TIMING
* LOOP IS USED; THERFORE, TIMING ROUTINES MUST
* BE CHANGED ON NON 1 MHZ SYSTEMS.
******************************
*
* [NDRAD F\R ATT PASSA MED KONTROLLERKORT
* C]-8017 TILL RT-DATORN.
* UTSKRIFTEN [R ANPASSAD F\R 40 TECKENS
* SK[RMBREDD.
* RESULTATET SOM PLOTTAS P] SK[RMEN
* [R [NDRAT S] ATT VARJE PUNKT MOTSVARAR
* 0.1% [NDRING AV HASTIGHETEN.
* AV N-O JOHANSSON.
******************************
*
*  +++DISKSPD,<DRIVE>
*
******************************

COMREG  EQU    $E018     1771 COMMAND REGISTER

* FLEX EQUATES

RESTOR  EQU    $DE09
TTYEOL  EQU    $CC03
NXTCHR  EQU    $CD27
GETCHR  EQU    $CD15
PSTRNG  EQU    $CD1E
PUTCHR  EQU    $CD18
PCRLF   EQU    $CD24
WARMS   EQU    $CD03

        ORG    $C100
DSKSPD  BRA    START
VN      FCB    2         FOR C]-8017 CONTROLLER
DRVNUM  RMB    1         DRIVE TO TEST
TIME    RMB    30        SPACE FOR 15 TIME VALUES
TSTCNT  RMB    1         TEST COUNTER

* GET DRIVE NUMBER FROM COMMAND LINE OR
* PROMPT USER IF NOT THERE
*

START   JSR    NXTCHR    GET DRIVE NUMBER
        CMPA   TTYEOL    MISSING?
        BEQ    PROMPT
        CMPA   #$D
        BEQ    PROMPT    GO ASK FOR DRIVE NUMBER
        SUBA   #$30      ASCII TO BINARY
        CMPA   #1
        LBGT   ERROR     NO SUCH DRIVE
        BRA    SELECT    DRIVE OK

PROMPT  LDX    #PRMSG    POINT AT MESSAGE
        JSR    PSTRNG
        JSR    GETCHR    GET RESPONSE
        SUBA   #$30
        CMPA   #1
        BGT    ERROR     NO SUCH DRIVE

SELECT  STA    DRVNUM    SELECT DRIVE
        LDX    #DRVNUM   GET READY FOR CALL TO FLEX
        LEAX   -3,X
        JSR    RESTOR    RESTOR TO TRACK 0
        BRA    TIMER

PRMSG   FCC    'DRIVE NUMBER TO BE TESTED? ',4

ERROR   LDX    #ERRMSG
        JSR    PSTRNG
        JMP    WARMS     RETURN TO FLEX

ERRMSG  FCC    'INVALID DRIVE NUMBER',4

TIMER   LDA    #15       DO 15 TIMING TESTS
        STA    TSTCNT    SAVE IN LOOP COUNTER
        LDX    #TIME     POINT AT START OF TIME TABLE
        SEI              MASK IRQ FOR TIMING LOOP
        LDA    #$D0      179X 'FORCE INTERRUPT' COMMAND
        STA    COMREG    INSURES 'TYPE 1' STATUS
        LBSR   DELAY     WAIT 32 uSEK

        LDB    #$08      17XX RESTOR,HEAD LOAD COMMAND
WAIT    LDY    #$0000    CLEAR TIMING REGISTER
        STB    COMREG    RESTOR AND GET TYPE 1 STATUS
        LDA    COMREG    LOOK FOR INDEX PULSE
        ANDA   #$02      IN BIT 1 OF COMREG
        BEQ    WAIT      LOOP UNTIL PULSE DETECTED

* TIMING LOOP BEGINS TO INCREMENT AFTER THE
* INDEX PULSE IS DETECTED, THROUGHOUT THE
* INTERVAL BETWEEN PULSES, AND STOPS WHEN
* THE INDEX PULSE IS DETECTED AGAIN.
*
CNTHI  LEAY    1,Y I     NCREMENT TIMING REGISTER
        STB    COMREG    UPDATE 1771 STATUSREGISTER
        LDA    COMREG    AND CHECK IF STILL IN INDEX PULSE
        ANDA   #$02
        BNE    CNTHI     YES, CONTINUE TO INCREMENT TIMER

CNTLOW  LEAY   1,Y       INCREMENT TIMER UNTIL
        STB    COMREG    NEXT INDEX PULSE DETECTED
        LDA    COMREG    STILL WAITING FOR INDEX PULSE?
        ANDA   #$02
        BEQ    CNTLOW    YES,CONTINUE TO INCREMENT TIMER

* STORE RESULT OF TEST
*
        STY    0,X++     STORE RESULT IN TIME TABLE
        DEC    TSTCNT    DONE 15 TESTS YET?
        BNE    WAIT      NO, DO ANOTHER TEST
        CLI              ALLOW INTERRUPT AGAIN
        BRA    GRAPH     DISPLAY RESULT

DELAY   LBSR   DEL1      DELAY ROUTINE
DEL1    LBSR   DEL
DEL     RTS

* TAKE RESULT OF 15 TESTS NOW STORED IN TIME
* TABLE AND GRAPH RESULTS ON SCREEN. A PERFECTLY
* ACCURATE DRIVE WILL YIELD A COUNT OF DEC 10000
* (HEX 2710). THAT VALUE WOULD RESULT IN A POINT
* BEING PLOTTED IN THE CENTER OF THE GRAPH
* A LOWER VALUE REPRESENTS A FASTER DRIVE AND
* VICE VERSA. THE GRAPH CONSISTS OF 39 'BINS'
* RANGING FROM APPRX 2% SLOW TO 2% FAST.
* THE CENTER BIN WILL HOLD POINTS RANGING FROM
* 9995 TO 1005, WITH 19 EQUAL SIZED BINS
* (REPRESENTING .1% INCREMENTS) ON EITHER SIDE
* OF CENTER.
*
GRAPH   LDX    #HEADER   PRINT HEADER
        JSR    PSTRNG
        LDB    #15       PLOT 15 TIME DATA POINTS
        STB    TSTCNT
        LDX    #TIME     X WILL BE POINTER INTO TIME TABLE

* CHECK FOR DATA POINT OUTSIDE RANGE OF GRAPH
*
RESULT  LDY    #9800     SEE IF MORE THAN 2% FAST
        CMPY   0,X
        LBGT   FAST
        LDY    #10200    SEE IF MORE THAN 2% SLOW
        CMPY   0,X
        LBLT   SLOW

* DATA POINT NOT TOO HIGH OR LOW,
* SO PLOT IT.
*
        LDY    #10200    EDGE OF SLOWEST CELL
PLOT    LEAY   -10,Y 10 IS SIZE OF CELL
        CMPY   0,X IN THIS CELL?
        BLE    PLTPNT YES, GO PLOT POINT
        LDA    #$20 NO, SO SKIP TO NEXT CELL
        JSR    PUTCHR PRINT THE SPACE
        BRA    PLOT
PLTPNT  LDA    #'* PLOT A DATA POINT
        JSR    PUTCHR
        JSR    PCRLF
NXTPNT  LEAX   2,X BUMP TABLE POINTER TO NEXT ENTRY
        LDB    TSTCNT CHECK TO SEE IF 15 POINTS PLOTTED
        DECB
        STB    TSTCNT
        BNE    RESULT

        LDX    #CMSG     ASK IF CONTINUE ANOTHER TEST
        JSR    PSTRNG
        JSR    GETCHR    GET ANSWER
        CMPA   #'N
        BEQ    EXIT      NO MORE TEST, GO TO FLEX
        CMPA   #'n
        LBNE   TIMER     YES, DO THE TEST AGAIN

EXIT    JMP    WARMS     RETURN TO FLEX

CMSG    FCC    'CONTINUE (Y*/N)? ',4

HEADER  FCC    $D,$A
        FCC    ' 0.1% SCALE',$D,$A
        FCC    'SLOW            CORRECT'
        FCC    '            FAST',$D,$A
        FCC    '-2%     -1%        V'
        FCC    '        +1%     +2%',$D,$A
        FCC    '____I____I____I____I'
        FCC    '____I____I____I____'
        FCC    4

SLOW    LDA    #'<
        JSR    PUTCHR    PRINT IT
        JSR    PCRLF
        LBRA   NXTPNT

FAST    LDB    #38       SPACE OVER 38 SPACES
SKIP    LDA    #$20
        JSR    PUTCHR    PRINT A SPACE
        DECB             DONE YET?
        BNE    SKIP      NO, PRINT ANOTHER SPACE
        LDA    #'>
        JSR    PUTCHR
        JSR    PCRLF
        LBRA   NXTPNT

        END    DSKSPD
